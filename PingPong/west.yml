## PingPong/west.yml
```yaml
#
# COPYRIGHT 2022 CONNECTED DEVELOPMENT, A DIVISION OF
# EXPONENTIAL TECHNOLOGY GROUP.
#
# SPDX-License-Identifier: Apache-2.0

# This is the top-level manifest file.  It contains the list of other repos and
# their revisions for the project build. The first repo is the nRF Connect SDK, 
# which is itself a manifest repo that references all other repos to be used in 
# the build. Next, this manifest references other repos that have been modified 
# by Connected Development for the project. These will override the unmodified 
# repos that are referenced in the nRF Connect SDK manifest. 

manifest:
  remotes:
    # The nRF Connect SDK base.
    - name: ncs
      url-base: https://github.com/nrfconnect

    # The CD repo base.
    - name: cdrepo
      url-base: https://github.com/ConnectedDevelopment

  projects:
    # Import the nRF Connect SDK.
    - name: nrf
      repo-path: sdk-nrf
      remote: ncs
      revision: v2.1.0
      import:
        # Skip the projects that we will override below.
        name-blocklist:
          - loramac-node
      clone-depth: 1

    # Override an nRF SDK repo with our modified fork copy:
    - name: zephyr-loramac-node
      # The remote name from above.
      remote: cdrepo
      # Version to clone:  Latest on develop_CD
      revision: 02ed274fc8db17b02a3e1d50a728bd211f4cb515
      # Relative local path specifying where to clone the repository.
      path: ConDev/modules/lib/loramac-node

  self:
    path: PingPong
```

## boards/arm/iotacomm_nrf52840/Kconfig
```kconfig
# IotaComm NRF52840 board configuration

# Copyright (c) 2023 CONNECTED DEVELOPMENT, A DIVISION OF
#   EXPONENTIAL TECHNOLOGY GROUP.

# Copyright (c) 2016 Nordic Semiconductor ASA
# SPDX-License-Identifier: Apache-2.0

if BOARD_IOTACOMM_NRF52840

# If many DBG logs are enabled, override the default log buffer size.
# This must be done before the original default value is defined in Kconfig.zephyr.
config LOG_BUFFER_SIZE
   int
   default 10240 if LBM_LOG_LEVEL_DBG || SPI_LOG_LEVEL_DBG || LBM_HAL_DBG_DEEP

config BOARD_ENABLE_DCDC
	bool "DCDC mode"
	select SOC_DCDC_NRF52X
	default y

config BOARD_ENABLE_DCDC_HV
	bool "High Voltage DCDC converter"
	select SOC_DCDC_NRF52X_HV
	default y

endif # BOARD_IOTACOMM_NRF52840
```

## boards/arm/iotacomm_nrf52840/Kconfig.board
```kconfig
# IotaComm NRF52840 board configuration

# Copyright (c) 2023 CONNECTED DEVELOPMENT, A DIVISION OF
#   EXPONENTIAL TECHNOLOGY GROUP.

# Copyright (c) 2016 Nordic Semiconductor ASA
# SPDX-License-Identifier: Apache-2.0

config BOARD_IOTACOMM_NRF52840
	bool "IotaComm NRF52840"
	depends on SOC_NRF52840_QIAA
```

## boards/arm/iotacomm_nrf52840/Kconfig.defconfig
```kconfig
# IotaComm NRF52840 board configuration

# Copyright (c) 2023 CONNECTED DEVELOPMENT, A DIVISION OF
#   EXPONENTIAL TECHNOLOGY GROUP.

# Copyright (c) 2016 Nordic Semiconductor ASA
# SPDX-License-Identifier: Apache-2.0

if BOARD_IOTACOMM_NRF52840

config BOARD
	default "iotacomm_nrf52840"

config BT_CTLR
	default BT

endif # BOARD_IOTACOMM_NRF52840
```

## boards/arm/iotacomm_nrf52840/iotacomm_nrf52840_defconfig
```kconfig
# Copyright (c) 2023 CONNECTED DEVELOPMENT, A DIVISION OF
#   EXPONENTIAL TECHNOLOGY GROUP.
#
# SPDX-License-Identifier: Apache-2.0

# Default config settings for the IotaComm board.

CONFIG_SOC_SERIES_NRF52X=y
CONFIG_SOC_NRF52840_QIAA=y
CONFIG_BOARD_IOTACOMM_NRF52840=y

# Enable MPU
CONFIG_ARM_MPU=y

# Enable hardware stack protection
CONFIG_HW_STACK_PROTECTION=y

# Enable RTT
CONFIG_USE_SEGGER_RTT=y

# Enable GPIO
CONFIG_GPIO=y

# Enable uart driver
CONFIG_SERIAL=y

# eNable console
CONFIG_CONSOLE=y
CONFIG_UART_CONSOLE=y

# Additional board options
CONFIG_GPIO_AS_PINRESET=y

CONFIG_PINCTRL=y

# SPI is used for the SX1262 LoRa interface.
CONFIG_SPI=y

# I2C is used for the BME680 pressure, temperature, humidity sensor interface.
CONFIG_I2C=y

# Enable sensor driver.
#CONFIG_SENSOR=y

# Enable MPU temperature sensor driver.
#CONFIG_NRFX_TEMP=y

#CONFIG_LORABASICSMODEM=y
#CONFIG_REGION_IOTA_800=y
#CONFIG_REGION_US_915=n
```

## boards/shields/semtech_sx1262_lora/Kconfig.defconfig
```kconfig
#
# COPYRIGHT 2022 CONNECTED DEVELOPMENT, A DIVISION OF
# EXPONENTIAL TECHNOLOGY GROUP.
#
# SPDX-License-Identifier: Apache-2.0

if SHIELD_SEMTECH_SX1262_LORA

if LORA

config SPI
	default y

endif # LORA

endif # SHIELD_SEMTECH_SX1262_LORA
```

## boards/shields/semtech_sx1262_lora/Kconfig.shield
```kconfig
#
# COPYRIGHT 2022 CONNECTED DEVELOPMENT, A DIVISION OF
# EXPONENTIAL TECHNOLOGY GROUP.
#
# SPDX-License-Identifier: Apache-2.0

config SHIELD_SEMTECH_SX1262_LORA
	def_bool $(shields_list_contains,semtech_sx1262_lora)
```
